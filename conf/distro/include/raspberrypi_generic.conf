## conf/distro/include/raspberrypi_generic.conf
```bitbake
PACKAGECONFIG_append_pn-wpeframework = " virtualinput"

PACKAGECONFIG_append_pn-wpeframework-clientlibraries = "\
    displayinfo deviceinfo cryptography cryptography_openssl cryptography_test playerinfo \
"

PACKAGECONFIG_append_pn-wpeframework-plugins = "\
    dialserver dial_youtube displayinfo filetransfer inputswitch languageadministrator \
    playerinfo power processmonitor resourcemonitor svalbard systemcommands webproxy webshell \
    streamer streamer_aamp \
"

PACKAGECONFIG_append_pn-wpeframework-plugins-rdk = " messenger packager"

DISTROOVERRIDES .= ":${DISTRO_CODENAME}"

# Select packages based on distro name selection
require raspberrypi_generic_dunfell.conf
require raspberrypi_generic_morty.conf
```

## conf/distro/include/raspberrypi_generic_dunfell.conf
```bitbake
PACKAGECONFIG_append_pn-wpeframework_dunfell = " ${@bb.utils.contains('DISTRO_FEATURES', 'container', 'processcontainers processcontainers_lxc', '', d)}"
PACKAGECONFIG_append_pn-wpeframework-plugins_dunfell = " ${@bb.utils.contains('DISTRO_FEATURES', 'container', 'processcontainers', '', d)}"

CMDLINE_append_pn-linux-raspberrypi_dunfell = " ${@bb.utils.contains('DISTRO_FEATURES', 'container', 'cgroup_enable=memory cgroup_memory=1', '', d)}"

PREFERRED_VERSION_gstreamer1.0-omx_dunfell = "1.16.%"
PREFERRED_VERSION_linux-raspberrypi_dunfell = "5.10.%"
```

## conf/distro/include/raspberrypi_generic_morty.conf
```bitbake
PREFERRED_VERSION_gstreamer1.0-omx_morty = "1.10.4"
PREFERRED_VERSION_linux-raspberrypi_morty = "4.9.%"

BBMASK_append_morty = " meta-metrological-raspberrypi/recipes-bsp/bootfiles/bootfiles.bbappend"
```

## conf/layer.conf
```bitbake
BBPATH .= ":${LAYERDIR}"

BBFILES += "\
            ${LAYERDIR}/recipes-*/*/*.bb \
            ${LAYERDIR}/recipes-*/*/*.bbappend \
           "

BBFILE_COLLECTIONS += "wpe-ml-layer"
BBFILE_PATTERN_wpe-ml-layer := "^${LAYERDIR}/"
BBFILE_PRIORITY_wpe-ml-layer = "20"

LAYERSERIES_COMPAT_wpe-ml-layer = "morthy sumo thud warrior zeus dunfell gatesgarth"

LAYERDEPENDS_wpe-ml-layer = " wpe-layer"

LICENSE_PATH += "${LAYERDIR}/licenses"
include whitelist.inc
include distro/include/raspberrypi_generic.conf
```
